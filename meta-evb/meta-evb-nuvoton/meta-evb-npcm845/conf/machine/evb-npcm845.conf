## meta-evb/meta-evb-nuvoton/meta-evb-npcm845/conf/machine/evb-npcm845.conf
```bitbake
#@TYPE: Machine
#@NAME: evb-npcm845
#@DESCRIPTION: NPCM845 EVB FB-OpenBMC

MACHINE = "evb-npcm845"
require conf/machine/include/npcm8xx.inc

IGPS_MACHINE = "EB"
DEVICE_GEN = "A1"

UBOOT_MACHINE = "ArbelEVB_defconfig"
UBOOT_DEVICETREE = "nuvoton-npcm845-evb"
UBOOT_SUFFIX ?= "bin"
EXTRA_IMAGEDEPENDS += "u-boot-nuvoton"

FLASH_SIZE = "65536"
FLASH_UBOOT_OFFSET:flash-65536 = "0"
FLASH_KERNEL_OFFSET:flash-65536 = "4096"
FLASH_ROFS_OFFSET:flash-65536 = "12288"
FLASH_RWFS_OFFSET:flash-65536 = "61440"

FLASH_FIT_OFFSET_KB = "4096"
UBOOT_PART_MAX_BYTES = "4194304"

BB_ALIGN = "524288"

KDEVICETREE = "nuvoton-npcm845-evb.dtb"
KERNEL_DEVICETREE = "nuvoton/${KDEVICETREE}"

# Prepare FIT image
KERNEL_CLASSES ?= "kernel_fitimage"
```
